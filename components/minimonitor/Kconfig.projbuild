## components/mm_io/Kconfig.projbuild
```kconfig
menu "Minimonitor - Additional GPIO devices"

    menu "Physical buttons"

        config MM_IO_PHYSICAL_BUTTONS
            int "Number of physical buttons"
            range 0 3
            default 0
            help
                Set the number of physical buttons available on the board.

        config MM_IO_LONG_PRESS_TIME_MS
            int "Long press time (ms)"
            default 500
            help
                Amount of time to press a button to trigger a long press action.

        # --- BUTTON 1 ---
        menu "Button 1 Settings"
            depends on MM_IO_PHYSICAL_BUTTONS >= 1

            config MM_IO_BTN1_GPIO
                int "GPIO pin"
                default 0

            choice MM_IO_BTN1_SINGLE_ACTION
                prompt "Single Press Action"
                default MM_IO_BTN1_SINGLE_NONE
                config MM_IO_BTN1_SINGLE_NONE
                    bool "Disabled"
                config MM_IO_BTN1_SINGLE_SNOOZE
                    bool "Snooze"
                config MM_IO_BTN1_SINGLE_LEFT
                    bool "Left Swipe"
                config MM_IO_BTN1_SINGLE_RIGHT
                    bool "Right Swipe"
                config MM_IO_BTN1_SINGLE_CYCLE
                    bool "Left/Right Swipe (cyclic)"
                config MM_IO_BTN1_SINGLE_HOME
                    bool "Return to home screen"
            endchoice

            choice MM_IO_BTN1_LONG_ACTION
                prompt "Long Press Action"
                default MM_IO_BTN1_LONG_NONE
                config MM_IO_BTN1_LONG_NONE
                    bool "Disabled"
                config MM_IO_BTN1_LONG_SNOOZE
                    bool "Snooze"
                config MM_IO_BTN1_LONG_LEFT
                    bool "Left Swipe"
                config MM_IO_BTN1_LONG_RIGHT
                    bool "Right Swipe"
                config MM_IO_BTN1_LONG_CYCLE
                    bool "Left/Right Swipe (cyclic)"
                config MM_IO_BTN1_LONG_HOME
                    bool "Return to home screen"
            endchoice
        endmenu

        # --- BUTTON 2 ---
        menu "Button 2 Settings"
            depends on MM_IO_PHYSICAL_BUTTONS >= 2

            config MM_IO_BTN2_GPIO
                int "GPIO pin"
                default 0

            choice MM_IO_BTN2_SINGLE_ACTION
                prompt "Single Press Action"
                default MM_IO_BTN2_SINGLE_NONE
                config MM_IO_BTN2_SINGLE_NONE
                    bool "Disabled"
                config MM_IO_BTN2_SINGLE_SNOOZE
                    bool "Snooze"
                config MM_IO_BTN2_SINGLE_LEFT
                    bool "Left Swipe"
                config MM_IO_BTN2_SINGLE_RIGHT
                    bool "Right Swipe"
                config MM_IO_BTN2_SINGLE_CYCLE
                    bool "Left/Right Swipe (cyclic)"
                config MM_IO_BTN2_SINGLE_HOME
                    bool "Return to home screen"
            endchoice

            choice MM_IO_BTN2_LONG_ACTION
                prompt "Long Press Action"
                default MM_IO_BTN2_LONG_NONE
                config MM_IO_BTN2_LONG_NONE
                    bool "Disabled"
                config MM_IO_BTN2_LONG_SNOOZE
                    bool "Snooze"
                config MM_IO_BTN2_LONG_LEFT
                    bool "Left Swipe"
                config MM_IO_BTN2_LONG_RIGHT
                    bool "Right Swipe"
                config MM_IO_BTN2_LONG_CYCLE
                    bool "Left/Right Swipe (cyclic)"
                config MM_IO_BTN2_LONG_HOME
                    bool "Return to home screen"
            endchoice
        endmenu

        # --- BUTTON 3 ---
        menu "Button 3 Settings"
            depends on MM_IO_PHYSICAL_BUTTONS >= 3

            config MM_IO_BTN3_GPIO
                int "GPIO pin"
                default 0

            choice MM_IO_BTN3_SINGLE_ACTION
                prompt "Single Press Action"
                default MM_IO_BTN3_SINGLE_NONE
                config MM_IO_BTN3_SINGLE_NONE
                    bool "Disabled"
                config MM_IO_BTN3_SINGLE_SNOOZE
                    bool "Snooze"
                config MM_IO_BTN3_SINGLE_LEFT
                    bool "Left Swipe"
                config MM_IO_BTN3_SINGLE_RIGHT
                    bool "Right Swipe"
                config MM_IO_BTN3_SINGLE_CYCLE
                    bool "Left/Right Swipe (cyclic)"
                config MM_IO_BTN3_SINGLE_HOME
                    bool "Return to home screen"
            endchoice

            choice MM_IO_BTN3_LONG_ACTION
                prompt "Long Press Action"
                default MM_IO_BTN3_LONG_NONE
                config MM_IO_BTN3_LONG_NONE
                    bool "Disabled"
                config MM_IO_BTN3_LONG_SNOOZE
                    bool "Snooze"
                config MM_IO_BTN3_LONG_LEFT
                    bool "Left Swipe"
                config MM_IO_BTN3_LONG_RIGHT
                    bool "Right Swipe"
                config MM_IO_BTN3_LONG_CYCLE
                    bool "Left/Right Swipe (cyclic)"
                config MM_IO_BTN3_LONG_HOME
                    bool "Return to home screen"
            endchoice
        endmenu

    endmenu

    # OTHER GPIO

    menu "Led strip"
        config MM_IO_HAS_LEDSTRIP
            bool "Enable LED strip support"
            default n
            help
                Enable support for an addressable LED strip (e.g., WS2812).

        if MM_IO_HAS_LEDSTRIP

            config MM_IO_LEDSTRIP_GPIO
                int "LED strip GPIO pin"
                default 0
                help
                GPIO number used for the LED strip data line.

            config MM_IO_LEDSTRIP_COUNT
                int "Number of LEDs"
                default 1
                range 1 512
                help
                Total number of LEDs in the strip.

            choice
                prompt "LED Strip Color Format"
                default MM_IO_LEDSTRIP_CF_RGB
                help
                    Select the color order used by the LED strip hardware.

                config MM_IO_LEDSTRIP_CF_RGB
                    bool "RGB Order"

                config MM_IO_LEDSTRIP_CF_GRB
                    bool "GRB Order"

            endchoice

            config MM_IO_LEDSTRIP_ANIM_SPEED_HZ
                int "LED strip animation speed (Hz)"
                default 50
                help
                    The speed of LED strip animations.

        endif
    endmenu

    menu "IMU sensor"

        config MM_IO_ROTATION_TASK_ADDITIONAL_STACK
            int "Rotation task additional stack size"
            default 1024
            help
                Additional stack space allocated to the rotation processing task in bytes.

        config MM_IO_ROTATION_TASK_PRIO
            int "Rotation task priority"
            default 2
            help
                The priority of the rotation task.

        config MM_IO_IMU_POLL_PERIOD_MS
            int "IMU poll period (ms)"
            default 50
            help
                The interval in milliseconds between IMU sensor reads.

        config MM_IO_IMU_ROTATION_CONFIRM_DELAY_MS
            int "IMU rotation confirmation delay (ms)"
            default 500
            help
                How long a rotation state must be stable before it is confirmed.

        config MM_IO_IMU_PARAM_TAN_A
            int "IMU Tan A parameter"
            default 2982
            help
                A parameter to specify how close the rotation should be close to the anchor points on the z rotation.
                Let alpha be the angle from the anchor point and the z current rotation, this parameter should be
                formatted as MM_IO_IMU_PARAM_SCALE * tan(alpha).

        config MM_IO_IMU_PARAM_TAN_B_SQUARE
            int "IMU Tan B squared parameter"
            default 8192
            help
                A parameter to specify how close the rotation should be to the anchor points with respect to xy
                inclination. Let beta be the angle from the xy plane and the current inclination, this parameter should be
                formatted as MM_IO_IMU_PARAM_SCALE * (tan(beta)^2).

        config MM_IO_IMU_PARAM_SCALE
            int "IMU parameter scale factor"
            default 8192
            help
                The scaling factor used for MM_IO_IMU_PARAM_TAN_A and MM_IO_IMU_PARAM_TAN_B_SQUARE.

    endmenu

    menu "USB OTG"
        config MM_IO_ENABLE_USB_OTG
        bool "Enable USB-OTG support"
        default n
        help
            Disables the USB-JTAG and enables USB-OTG through tinyusb.

        if MM_IO_ENABLE_USB_OTG

            config MM_IO_ENABLE_USB_MSC
            bool "Enable USB MSC"
            depends on MM_PORT_HAS_SDCARD
            default n
            help
                 Use the device as USB mass storage (requires an SD Card).

            config MM_IO_ENABLE_USB_HID
            bool "Enable USB HID"
            depends on TINYUSB_HID_COUNT > 0
            default n
            help
                 Use the device as USB HID for keyboard/mouse emulation.

            if MM_IO_ENABLE_USB_HID
                config MM_IO_USB_HID_TASK_ADDITIONAL_STACK
                    int "HID scheduler task additional stack size"
                    default 2024
                    help
                        Additional stack space allocated to the HID scheduler task in bytes.

                config MM_IO_USB_HID_TASK_PRIO
                    int "HID scheduler task priority"
                    default 3
                    help
                        The priority of the HID scheduler task. (recommended value: higher than mm_event task)
            endif

            config MM_IO_TUSB_SEND_TIMEOUT_MS
                int "Timeout for sending HID reports (ms)"
                default 500
                help
                    The maximum time to wait when sending an HID report.

        endif

    endmenu

    config MM_IO_LOG_LEVEL
        int "Maximum log level"
        range 0 6
        default 4
        help
            Maximum log level for this component

endmenu
```

## components/mm_net/Kconfig.projbuild
```kconfig
menu "Minimonitor - Network"

    menu "Station"
        choice MM_NET_WIFI_SAE_MODE
            prompt "WPA3 SAE mode selection"
            default MM_NET_WIFI_WPA3_SAE_PWE_HUNT_AND_PECK
            help
                Select mode for SAE as Hunt and Peck, H2E or both.
            config MM_NET_WIFI_WPA3_SAE_PWE_HUNT_AND_PECK
                bool "HUNT AND PECK"
            config MM_NET_WIFI_WPA3_SAE_PWE_HASH_TO_ELEMENT
                bool "H2E"
                depends on ESP_WIFI_ENABLE_SAE_H2E
            config MM_NET_WIFI_WPA3_SAE_PWE_BOTH
                bool "BOTH"
                depends on ESP_WIFI_ENABLE_SAE_H2E
        endchoice

        config MM_NET_WIFI_PW_ID
            string "PASSWORD IDENTIFIER"
            depends on  MM_NET_WIFI_WPA3_SAE_PWE_HASH_TO_ELEMENT || MM_NET_WIFI_WPA3_SAE_PWE_BOTH
            default ""
            help
                password identifier for SAE H2E

        choice MM_NET_WIFI_SCAN_AUTH_MODE_THRESHOLD
            prompt "WiFi Scan auth mode threshold"
            default MM_NET_WIFI_AUTH_WPA_WPA2_PSK
            help
                The weakest authmode to accept in the scan mode.
                This value defaults to MM_NET_WIFI_AUTH_WPA2_PSK in case password is present and MM_NET_WIFI_AUTH_OPEN is used.
                Please select MM_NET_WIFI_AUTH_WEP/MM_NET_WIFI_AUTH_WPA_PSK in case AP is operating in WEP/WPA mode.

            config MM_NET_WIFI_AUTH_OPEN
                bool "OPEN"
            config MM_NET_WIFI_AUTH_WEP
                bool "WEP"
            config MM_NET_WIFI_AUTH_WPA_PSK
                bool "WPA PSK"
            config MM_NET_WIFI_AUTH_WPA2_PSK
                bool "WPA2 PSK"
            config MM_NET_WIFI_AUTH_WPA_WPA2_PSK
                bool "WPA/WPA2 PSK"
            config MM_NET_WIFI_AUTH_WPA3_PSK
                bool "WPA3 PSK"
            config MM_NET_WIFI_AUTH_WPA2_WPA3_PSK
                bool "WPA2/WPA3 PSK"
            config MM_NET_WIFI_AUTH_WAPI_PSK
                bool "WAPI PSK"
        endchoice

        config MM_NET_RECONNECT_DELAY_MS
            int "WiFi reconnect delay"
            default 5000
            help
                Time to wait between reconnections.
    endmenu

    menu "HTTP server"
        
        config MM_NET_HTTP_SERVER_PORT
            int "HTTP server port"
            default 80
            
        config MM_NET_HTTP_QUERY_ARG_MAX_LEN
            int "Max query string length" if MM_EXPERT
            default 80
            help
                Maximum supported length for query string parameters.

    endmenu

    config MM_NET_LOG_LEVEL
        int "Maximum log level"
        range 0 6
        default 4
        help
            Maximum log level for this component

endmenu
```

## components/mm_port/Kconfig.projbuild
```kconfig
menu "Minimonitor - Porting"
    
    # we need to make this visible because otherwise it will not be
    # overriden by sdkconfig defaults
    config MM_PORT_TARGET_BOARD
        string "Target board"
        default ""
        help
            Please only change this value from sdkconfig.defaults

    # LCD SCREEN SETTINGS

    config MM_PORT_LCD_H_RES
        int "Horizontal Resolution"
        default 0

    config MM_PORT_LCD_V_RES
        int "Vertical Resolution"
        default 0

    choice MM_PORT_LCD_ROTATION
        prompt "LCD Rotation"
        default MM_PORT_LCD_ROTATION_0
        help
            Select the screen orientation in degrees.

        config MM_PORT_LCD_ROTATION_0
            bool "0"
        config MM_PORT_LCD_ROTATION_90
            bool "90"
        config MM_PORT_LCD_ROTATION_180
            bool "180"
        config MM_PORT_LCD_ROTATION_270
            bool "270"
    endchoice

    config MM_PORT_LVGL_TICK_RESOLUTION_MS
        int "LVGL tick resolution (ms)"
        default 2
        help
            The period of the LVGL system tick.

    config MM_PORT_DISABLE_ROTATION_PORTRAIT
        bool "Disable portrait rotation"
        default y
        help
            If enabled, the display driver will only rotate horizontally. Please note that this is relative to the
            MM_PORT_LCD_ROTATION value. This option makes sense on screens that are so narrow that readjusting the UI
            is simply not beneficial.

    config MM_PORT_HAS_TOUCHSCREEN
        bool "Board touchscreen support"
        default n
        help
            Enable this if your board has a touchscreen.

    config MM_PORT_HAS_IMU
        bool "Gyroscope sensor support"
        default n
        help
            Enable this if your board has an IMU.

    menuconfig MM_PORT_HAS_SDCARD
        bool "SD card support"
        default n
        help
            Enable this if your board supports external storage.
    
    config MM_PORT_SDCARD_MOUNT_POINT
        string "Mount point name for SD card" if MM_EXPERT
        default "/sdcard"
        depends on MM_PORT_HAS_SDCARD
    
    config MM_PORT_SDCARD_ICON_DIR
        string "Directory where to read images on SD card" if MM_EXPERT
        default "img"
        depends on MM_PORT_HAS_SDCARD

    config MM_PORT_LOG_LEVEL
        int "Maximum log level"
        range 0 6
        default 4
        help
            Maximum log level for this component

    # INCLUDE BOARD SPECIFIC CONFIGURATION

    if MM_PORT_TARGET_BOARD = "waveshare_c6_lcd_1_47"
        orsource "waveshare_c6_lcd_1_47/Kconfig"
    endif        
    # ...
    # add other boards here
    # ...
    if MM_PORT_TARGET_BOARD = "generic_board"
        orsource "generic_board/Kconfig"
    endif
    

endmenu
```
