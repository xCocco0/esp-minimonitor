## components/minimonitor/Kconfig.projbuild
```kconfig
menu "Minimonitor"

    config MM_EXPERT
        bool "Expert mode"
        default false
        help
            Enables additional configuration options

    config MM_PERIODIC_RAM_REPORT
        bool "Periodic RAM usage report" if MM_EXPERT
        default false

    if MM_PERIODIC_RAM_REPORT

        config MM_PERIODIC_RAM_REPORT_PERIOD_S
            int "Periodic RAM usage report period (seconds)" if MM_EXPERT
            default 300

    endif

    config MM_EVENT_TRACE_CPU_USAGE
        bool "Trace events CPU usage"
        default false
        help
            If enabled, measure CPU time consumed by each of the Minimonitor events.
            Config FREERTOS_USE_TRACE_FACILITY is strongly recommended for detailed reports.

    choice MM_ICON_SET
        prompt "Icon set to compile"
        default MM_ICON_SET_ALL
        help
            Choose to compile all icons or a reduced amount to save flash memory.

        config MM_ICON_SET_ALL
            bool "All (recommended)"
        config MM_ICON_SET_MINIMAL
            bool "Minimal"

    endchoice

    # NOTE: global level is set by CONFIG_LOG_MAXIMUM_LEVEL
    config MM_LOG_LEVEL
        int "Maximum log level"
        range 0 6
        default 4
        help
            Maximum log level for this component

    menu "Event queue"

        config MM_EVENT_QUEUE_LEN
            int "Event queue length"
            default 32
            help
                The number of events the event queue can hold before dropping new ones.

        config MM_EVENT_TASK_PRIO
            int "Event task priority"
            default 2
            help
                Priority level for the event task.

        config MM_EVENT_TASK_ADDITIONAL_STACK
            int "Additional stack size for event task"
            default 2560
            help
                Additional stack size space with respect to the minimal size.

        config MM_EVENT_TASK_PERIOD_MS
            int "Event task period (ms)"
            default 10
            help
                The period of the event task in milliseconds.

        config MM_NOTIF_FLASH_SINGLE_MS
            int "Single flash duration (ms)"
            default 350
            help
                Duration of a single notification flash in milliseconds.

        config MM_NOTIF_DEFAULT_DURATION
            int "Default notification duration (ms)"
            default 5000
            help
                Default notification popup/flash duration.

        config MM_SENSOR_LABEL_MAX_LEN
            int "Max sensor label length" if MM_EXPERT
            default 64

        config MM_SENSOR_DESC_FMT_MAX_LEN
            int "Max sensor description format length" if MM_EXPERT
            default 64

        config MM_SENSOR_PANEL_FMT_MAX_LEN
            int "Max sensor panel format length" if MM_EXPERT
            default 64

    endmenu

    menu "Keyboard/Mouse emulation"

        config MM_HID_CONTROL_MATRIX_MAX_BTN
            int "Maximum buttons in HID matrix widget"
            default 4
            help
                The maximum number of buttons supported in the HID matrix widget.

        config MM_HID_MAX_NKRO
            int "Maximum combined keys to be send"
            default 6
            range 1 14
            help
                The maximum number of concurrent key presses to be sent. Please note that there are also other USB
                constraints to be take into consideration: maximum 6 keyboards keys + 8 modifiers and maximum 8 mouse
                buttons.

        config MM_HID_DEFAULT_PRESS_DURATION_MS
            int "Default HID press duration (ms)"
            default 30
            help
                The default press duration in milliseconds for a button press.

        config MM_MAX_ICON_NAME_LEN
            int "Maximum icon name length" if MM_EXPERT
            default 24
            help
                The maximum string length allowed for icon names (including the null terminator).

        menu "Touchpad"

            config MM_TP_DEFAULT_QUICK_TAP_MS
                int "Maximum quick tap time (ms)"
                default 150
                help
                    The maximum duration of a tap to be considered quick.

            config MM_TP_DEFAULT_LONG_TAP_MS
                int "Minimum long tap time (ms)"
                default 600
                help
                    The minimum duration of a tap to be considered long.

            config MM_TP_DEFAULT_DOUBLE_TAP_MS
                int "Maximum double tap delay (ms)"
                default 200
                help
                    Maximum delay between taps to be considered a double tap.

            config MM_TP_DEFAULT_DMAX_PX
                int "Default maximum movement distance (px)"
                default 2
                help
                    The maximum distance in pixels for a touch to still be considered a tap.

            config MM_TP_DEFAULT_ACCELERATION_GAIN
                int "Default acceleration gain"
                default 350
                range 0 65535
                help
                    The default acceleration gain value for the touchpad.

            config MM_TP_DEFAULT_RESPONSIVENESS
                int "Default responsiveness"
                default 15
                range 1 100
                help
                    The responsiveness factor for cursor movement smoothing.

            config MM_TP_DEFAULT_X_SENSITIVITY
                int "Default X-axis sensitivity"
                default 100
                range 1 65535
                help
                The default sensitivity percentage or scaling factor for the X-axis.

            config MM_TP_DEFAULT_Y_SENSITIVITY
                int "Default Y-axis sensitivity"
                default 100
                range 1 65535
                help
                The default sensitivity percentage or scaling factor for the Y-axis.

        endmenu

    endmenu

endmenu
```

## components/mm_cli/Kconfig.projbuild
```kconfig
menu "Minimonitor - Command line interface"

    config MM_CLI_LINE_BUF_SIZE
        int "Line buffer size"
        default 256

    config MM_CLI_MAX_PROMPT_LEN
        int "Max length for CLI prompt" if MM_EXPERT
        default 24
        help
            The length of the prompt at the start of the line before the > symbol.

    config MM_CLI_MAX_LINE_LEN
        int "Max CLI line length" if MM_EXPERT
        default 256
        help
            The maximum length of a line in the console.

    config MM_CLI_MAX_ARG_NUM
        int "Max number of CLI arguments" if MM_EXPERT
        default 32
        help
            The maximum number of arguments to parse in a line.

    config MM_CLI_HISTORY_SIZE
        int "Size of CLI history"
        default 32
        help
            The maximum line to store in the history buffer.

    config MM_CLI_TASK_ADDITIONAL_STACK
        int "Additional stack size for the REPL task"
        default 2048
        help
            Additional stack size space with respect to the minimal size.

    config MM_CLI_TASK_PRIO
        int "CLI task priority"
        default 1
        help
            Priority level for the CLI task.

    config MM_CLI_PROMPT_COLOR
        int "Prompt color"
        default 36
        help
            The ANSI color for the hostname in the CLI prompt.

    config MM_CLI_LOG_LEVEL
        int "Maximum log level"
        range 0 6
        default 4
        help
            Maximum log level for this component

endmenu
```
