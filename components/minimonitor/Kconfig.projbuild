## components/mm_port/generic_board/Kconfig
```kconfig
menu "Generic board configuration"
    
    menu "LCD configuration"

        orsource "Kconfig.lcd"

    endmenu

    menu "UI configuration"

        orsource "Kconfig.ui"

    endmenu

endmenu
```

## components/mm_port/generic_board/Kconfig.lcd
```kconfig
config MM_PORT_LCD_OFFSET_X # ignore: multiple-definition
    int "X Offset"
    default 0

config MM_PORT_LCD_OFFSET_Y
    int "Y Offset"
    default 0

config MM_PORT_LCD_MIRROR_X
    bool "Mirror screen on X axis"
    default 0

config MM_PORT_LCD_MIRROR_Y
    bool "Mirror screen on Y axis"
    default 0

config MM_PORT_LCD_SWAP_XY
    bool "Swap screen X and Y coordinates"
    default 0

config MM_PORT_LCD_INVERT_COLOR
    bool "Invert screen colors"
    default 0

choice MM_PORT_LCD_INTERFACE
    prompt "LCD Interface Type"
    default MM_PORT_LCD_INTERFACE_SPI
    help
        Choose between SPI or I2C communication.

    config MM_PORT_LCD_INTERFACE_SPI
        bool "SPI"
    config MM_PORT_LCD_INTERFACE_I2C
        bool "I2C"
        help 
            Warning! I2C is still not fully supported.
endchoice

menu "GPIO Pins"
    config MM_PORT_LCD_GPIO_BL
        int "Backlight GPIO"
        default -1

    config MM_PORT_LCD_GPIO_DC
        int "Data/Command (DC) GPIO"
        default -1

    config MM_PORT_LCD_GPIO_CS
        int "Chip Select (CS) GPIO"
        default -1

    config MM_PORT_LCD_GPIO_RST
        int "Reset (RST) GPIO"
        default -1

    # SPI Specific Pins
    config MM_PORT_LCD_GPIO_SCLK
        int "SPI SCLK GPIO"
        depends on MM_PORT_LCD_INTERFACE_SPI
        default -1

    config MM_PORT_LCD_GPIO_MOSI
        int "SPI MOSI GPIO"
        depends on MM_PORT_LCD_INTERFACE_SPI
        default -1

    config MM_PORT_LCD_GPIO_MISO
        int "SPI MISO GPIO"
        depends on MM_PORT_LCD_INTERFACE_SPI
        default -1

    # I2C Specific Pins
    config MM_PORT_LCD_GPIO_SCL
        int "I2C SCL GPIO"
        depends on MM_PORT_LCD_INTERFACE_I2C
        default -1

    config MM_PORT_LCD_GPIO_SDA
        int "I2C SDA GPIO"
        depends on MM_PORT_LCD_INTERFACE_I2C
        default -1
endmenu

menu "Performance and Buffer Settings"

    config MM_PORT_LCD_DRAW_BUFF_HEIGHT
        int "Draw Buffer Height"
        default 80
        help
            Draw buffer width is always equal to screen width.

    config MM_PORT_LCD_DRAW_BUFF_DOUBLE
        bool "Use Double Buffering"
        default y

    config MM_PORT_LCD_BUFF_DMA
        bool "Allocate buffer in DMA-capable memory"
        default n

    config MM_PORT_LCD_BUFF_IN_SPIRAM
        bool "Allocate buffer in SPIRAM"
        default n

    config MM_PORT_LCD_PIXEL_CLOCK_HZ
        int "Pixel Clock Speed (Hz)"
        default 12000000
endmenu

menu "Advanced Hardware Settings"
    config MM_PORT_LCD_BITS_PER_PIXEL
        int "Bits Per Pixel"
        default 16

    config MM_PORT_LCD_CMD_BITS
        int "Command Bits"
        default 8

    config MM_PORT_LCD_PARAM_BITS
        int "Parameter Bits"
        default 8

    config MM_PORT_LCD_SPI_MODE
        int "SPI Mode"
        depends on MM_PORT_LCD_INTERFACE_SPI
        range 0 3
        default 0

    config MM_PORT_LCD_SPI_NUM
        int "SPI host number"
        depends on MM_PORT_LCD_INTERFACE_SPI
        range 0 3
        default 0
        help
            The SPI peripheral to use (write 2 for SPI2_HOST)

    config MM_PORT_LCD_SPI_TRANS_QUEUE
        int "SPI transmission queue length"
        depends on MM_PORT_LCD_INTERFACE_SPI
        default 10

    config MM_PORT_LCD_I2C_HW_ADDR
        hex "I2C Hardware Address"
        depends on MM_PORT_LCD_INTERFACE_I2C
        default 0x0
        
    choice MM_PORT_LCD_DATA_ENDIANNESS
        prompt "LCD Data Endianness"
        default MM_PORT_LCD_DATA_LITTLE_ENDIAN
        config MM_PORT_LCD_DATA_LITTLE_ENDIAN
            bool "Little Endian"
        config MM_PORT_LCD_DATA_BIG_ENDIAN
            bool "Big Endian"
    endchoice

    choice MM_PORT_LCD_RGB_ENDIANNESS
        prompt "LCD RGB Element Order"
        default MM_PORT_LCD_RGB_ENDIAN_RGB
        config MM_PORT_LCD_RGB_ENDIAN_RGB
            bool "RGB"
        config MM_PORT_LCD_RGB_ENDIAN_BGR
            bool "BGR"
    endchoice
endmenu

menu "Backlight Settings"
    config MM_PORT_LCD_BL_ON_LEVEL
        int "Backlight On Level (0 or 1)"
        range 0 1
        default 1

    config MM_PORT_LEDC_HS_TIMER
        int "LEDC Timer Number"
        range 0 3
        default 0

    config MM_PORT_LEDC_HS_CHANNEL
        int "LEDC Channel Number"
        range 0 7
        default 0

endmenu
```

## components/mm_port/generic_board/Kconfig.ui
```kconfig
# font size

config MM_PORT_FONT_SIZE_TINY
    int "Font size: Tiny"
    default 14
    help
        Font size for notification icon badge.

config MM_PORT_FONT_SIZE_VERY_SMALL
    int "Font size: Very Small"
    default 14
    help
        Font size for labels inside bars.

config MM_PORT_FONT_SIZE_SMALL
    int "Font size: Small"
    default 14
    help
        Font size for labels beside bars and toast notifications.

config MM_PORT_FONT_SIZE_NORMAL
    int "Font size: Normal"
    default 14
    help
        Font size for clock and fps monitor.

config MM_PORT_FONT_SIZE_LARGE
    int "Font size: Large"
    default 14
    help
        Font size to use for larger clock.

config MM_PORT_FONT_SIZE_VERY_LARGE
    int "Font size: Very Large"
    default 14
    help
        Font size to use when only clock is shown.
```

## components/mm_ui/Kconfig.projbuild
```kconfig
menu "Minimonitor - GUI"

    config MM_UI_ANIMATED
        bool "Enable UI animations"
        default y
        help
            Enable smooth transitions and animated elements within the interface.

    config MM_UI_ANIM_SPEED
        int "Animation speed"
        default 100
        depends on MM_UI_ANIMATED
        help
            The global speed factor for UI animations. Higher is faster. Write 100 for default length.

    config MM_UI_ZOOM_IMAGE
        bool "Enable image zooming"
        default y
        help
            Allow the UI to scale or zoom images for better visibility.

    config MM_UI_USE_CALENDAR
        bool "Enable calendar widget"
        default n
        help
            Include the calendar widget to the UI.
            
    choice MM_UI_NOTIF_COUNT_LABEL_LIMIT
        prompt "Maximum number for notification icon label" if MM_EXPERT
        default MM_UI_NOTIF_COUNT_LABEL_LIMIT_100
        help
            The maximum number to use for the small label near the notification icon. After this value has been reached.
            notifications are still received but the label will show a + and stop counting.

        config MM_UI_NOTIF_COUNT_LABEL_LIMIT_10
            bool "10"
        config MM_UI_NOTIF_COUNT_LABEL_LIMIT_100
            bool "100"

    endchoice

    config MM_UI_BTN_SNOOZE_COLOR
        hex "Snooze button color"
        default 0xE85D75

    config MM_UI_BTN_SHUTDOWN_COLOR
        hex "Shutdown button color"
        default 0xFB5012

    config MM_UI_BTN_REBOOT_COLOR
        hex "Reboot button color"
        default 0x51A23F

    config MM_UI_BTN_ENABLENOTIF_COLOR
        hex "Enable notifications button color"
        default 0x388fa4

    config MM_UI_BTN_ROTATION_COLOR
        hex "Rotation button color"
        default 0xB4B84B

    config MM_UI_BTN_DISABLED_COLOR
        hex "Disabled state button color"
        default 0x404040

    config MM_UI_LOG_LEVEL
        int "Maximum log level"
        range 0 6
        default 4
        help
            Maximum log level for this component
        
endmenu
```

## components/mm_utils/Kconfig.projbuild
```kconfig
menu "Minimonitor - Utils"

    config MM_UTILS_CONF_REFRESH_INTERVAL_MS
        int "Config refresh interval (ms)"
        default 2000
        help
            How often to call nvs commit.
            Note: currently the esp_nvs_commit function is empty, so this is useless.

    config MM_LOG_HISTORY_BYTES
        int "Log history buffer size (bytes)"
        default 4000
        help
            The size of the ring buffer used for storing log history.

    config MM_LOG_MAX_LINE_LENGTH
        int "Maximum log line length"
        default 180
        help
            Characters allowed for each log entry line.

    config MM_UTILS_LOG_LEVEL
        int "Maximum log level"
        range 0 6
        default 4
        help
            Maximum log level for this component

endmenu
```

## sdkconfig.defaults
```kconfig
### LVGL settings ###

CONFIG_LV_USE_BTNMATRIX=y
CONFIG_LV_USE_CANVAS=y
CONFIG_LV_USE_CHECKBOX=n
CONFIG_LV_USE_DROPDOWN=n
CONFIG_LV_LABEL_TEXT_SELECTION=n
CONFIG_LV_USE_ROLLER=n
CONFIG_LV_USE_SLIDER=y
CONFIG_LV_USE_SWITCH=n
CONFIG_LV_USE_TEXTAREA=n
CONFIG_LV_USE_TABLE=n

CONFIG_LV_USE_ANIMIMG=n
CONFIG_LV_USE_CALENDAR=y
CONFIG_LV_USE_CALENDAR_HEADER_ARROW=n
CONFIG_LV_USE_CALENDAR_HEADER_DROPDOWN=n
CONFIG_LV_USE_CHART=n
CONFIG_LV_USE_COLORWHEEL=n
CONFIG_LV_USE_IMGBTN=n
CONFIG_LV_USE_KEYBOARD=n
CONFIG_LV_USE_LED=n
CONFIG_LV_USE_LIST=y
CONFIG_LV_USE_MENU=n
CONFIG_LV_USE_METER=n
CONFIG_LV_USE_MSGBOX=n
CONFIG_LV_USE_SPAN=n
CONFIG_LV_USE_SPINBOX=n
CONFIG_LV_USE_SPINNER=n
CONFIG_LV_USE_TABVIEW=n
CONFIG_LV_USE_TILEVIEW=y
CONFIG_LV_USE_WIN=n
CONFIG_LV_USE_QRCODE=y

CONFIG_LV_THEME_DEFAULT_DARK=y

CONFIG_LV_BUILD_EXAMPLES=n
CONFIG_LV_USE_FS_STDIO=y
CONFIG_LV_FS_STDIO_LETTER=65
CONFIG_LV_USE_PNG=y
CONFIG_LV_IMG_CACHE_DEF_SIZE=1
CONFIG_LV_MEM_CUSTOM=y
CONFIG_LV_MEM_CUSTOM_INCLUDE="stdlib.h"
CONFIG_LV_USE_LOG=y
CONFIG_LV_LOG_LEVEL_NONE=y
CONFIG_LV_LOG_LEVEL=5

CONFIG_LV_FONT_MONTSERRAT_8=y
CONFIG_LV_FONT_MONTSERRAT_10=y
CONFIG_LV_FONT_MONTSERRAT_12=y
CONFIG_LV_FONT_MONTSERRAT_14=y
CONFIG_LV_FONT_MONTSERRAT_16=y
CONFIG_LV_FONT_MONTSERRAT_18=y
CONFIG_LV_FONT_MONTSERRAT_20=y
CONFIG_LV_FONT_MONTSERRAT_22=y
CONFIG_LV_FONT_MONTSERRAT_24=y
CONFIG_LV_FONT_MONTSERRAT_26=y
CONFIG_LV_FONT_MONTSERRAT_28=y
CONFIG_LV_FONT_MONTSERRAT_30=y
CONFIG_LV_FONT_MONTSERRAT_32=y
CONFIG_LV_FONT_MONTSERRAT_34=y
CONFIG_LV_FONT_MONTSERRAT_36=y
CONFIG_LV_FONT_MONTSERRAT_38=y
CONFIG_LV_FONT_MONTSERRAT_40=y
CONFIG_LV_FONT_MONTSERRAT_42=y
CONFIG_LV_FONT_MONTSERRAT_44=y
CONFIG_LV_FONT_MONTSERRAT_46=y
CONFIG_LV_FONT_MONTSERRAT_48=y

###

# custom partition table
CONFIG_PARTITION_TABLE_CUSTOM=y
CONFIG_PARTITION_TABLE_CUSTOM_FILENAME="partitions.csv"
CONFIG_PARTITION_TABLE_FILENAME="partitions.csv"

CONFIG_ESPTOOLPY_FLASHSIZE_4MB=y
CONFIG_ESPTOOLPY_FLASHSIZE="4MB"

# enable coredump
CONFIG_ESP_COREDUMP_ENABLE=y
CONFIG_ESP_COREDUMP_ENABLE_TO_FLASH=y
CONFIG_ESP_COREDUMP_DATA_FORMAT_ELF=y

# enable web sockets
CONFIG_HTTPD_WS_SUPPORT=y

# to change log levels at runtime
CONFIG_LOG_DYNAMIC_LEVEL_CONTROL=y

# enable longer names on sdcard
CONFIG_FATFS_LFN_HEAP=y

# enable console output on the serial
# CONFIG_ESP_CONSOLE_UART_DEFAULT is not set
CONFIG_ESP_CONSOLE_USB_SERIAL_JTAG=y
# CONFIG_ESP_CONSOLE_UART_CUSTOM is not set
# CONFIG_ESP_CONSOLE_NONE is not set
CONFIG_ESP_CONSOLE_SECONDARY_NONE=y
CONFIG_ESP_CONSOLE_USB_SERIAL_JTAG_ENABLED=y
CONFIG_ESP_CONSOLE_UART_NUM=-1
CONFIG_ESP_CONSOLE_ROM_SERIAL_PORT_NUM=3

CONFIG_MM_EVENT_TASK_ADDITIONAL_STACK=2560

# default MM log levels

CONFIG_MM_LOG_LEVEL=4
CONFIG_MM_CLI_LOG_LEVEL=4
CONFIG_MM_IO_LOG_LEVEL=4
CONFIG_MM_NET_LOG_LEVEL=4
CONFIG_MM_PORT_LOG_LEVEL=4
CONFIG_MM_UI_LOG_LEVEL=4
CONFIG_MM_UTILS_LOG_LEVEL=4

#CONFIG_TINYUSB_HID_COUNT=1
```
